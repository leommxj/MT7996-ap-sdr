## platform/chainloader/configs/an7581_xr1710g_chainloader_defconfig
```kconfig
CONFIG_ARM=y
CONFIG_ARCH_AIROHA=y
CONFIG_TARGET_AN7581=y
CONFIG_POSITION_INDEPENDENT=y
CONFIG_LINUX_KERNEL_IMAGE_HEADER=y
CONFIG_TEXT_BASE=0x81E00000
CONFIG_LNX_KRNL_IMG_TEXT_OFFSET_BASE=0x81E00000
CONFIG_SYS_MALLOC_F_LEN=0x4000
CONFIG_NR_DRAM_BANKS=1
CONFIG_ENV_SIZE=0x4000
CONFIG_ENV_OFFSET=0x0
CONFIG_DEFAULT_DEVICE_TREE="airoha/an7581-w1700k-ubi"
CONFIG_SYS_LOAD_ADDR=0x81800000
CONFIG_BUILD_TARGET="u-boot.bin"
CONFIG_FIT=y
CONFIG_FIT_VERBOSE=y
CONFIG_AUTOBOOT=y
CONFIG_AUTOBOOT_KEYED=y
CONFIG_AUTOBOOT_MENU_SHOW=y
CONFIG_BOOTDELAY=5
CONFIG_BOOTCOUNT_LIMIT=y
CONFIG_BOOTCOUNT_ENV=y
# CONFIG_BOOTSTD is not set
# CONFIG_EXPO is not set
# CONFIG_EFI_LOADER is not set
CONFIG_HUSH_PARSER=y
CONFIG_SYS_PROMPT="XR1710G chainloader> "
CONFIG_SYS_MAXARGS=16
CONFIG_SYS_PBSIZE=1049
# CONFIG_DISPLAY_BOARDINFO is not set
CONFIG_CMD_BOOTM=y
CONFIG_CMD_BOOTMENU=y
CONFIG_CMD_MTD=y
CONFIG_CMD_UBI=y
CONFIG_CMD_SAVEENV=y
CONFIG_CMD_EDITENV=y
CONFIG_CMD_HASH=y
CONFIG_CMD_IMI=y
CONFIG_CMD_PING=y
CONFIG_CMD_TFTPBOOT=y
CONFIG_CMD_DHCP=y
CONFIG_CMD_RUN=y
CONFIG_CMD_TEST=y
CONFIG_CMD_ECHO=y
CONFIG_OF_UPSTREAM=y
# CONFIG_ENV_IS_IN_MTD is not set
CONFIG_ENV_IS_IN_UBI=y
CONFIG_ENV_REDUNDANT=y
CONFIG_ENV_UBI_PART="ubi"
CONFIG_ENV_UBI_VOLUME="ubootenv"
CONFIG_ENV_UBI_VOLUME_REDUND="ubootenv2"
CONFIG_ENV_UBI_VID_OFFSET=0
CONFIG_ENV_RELOC_GD_ENV_ADDR=y
CONFIG_ENV_USE_DEFAULT_ENV_TEXT_FILE=y
CONFIG_ENV_DEFAULT_ENV_TEXT_FILE="defenvs/an7581_xr1710g_chainloader_env"
CONFIG_ENV_OVERWRITE=y
CONFIG_NET_RANDOM_ETHADDR=y
CONFIG_SYS_RX_ETH_BUFFER=8
CONFIG_REGMAP=y
CONFIG_SYSCON=y
CONFIG_CLK=y
CONFIG_DMA=y
CONFIG_MTD=y
CONFIG_DM_MTD=y
CONFIG_MTD_SPI_NAND=y
CONFIG_AIROHA_ETH=y
CONFIG_DM_MDIO=y
CONFIG_PHY=y
CONFIG_PINCTRL=y
CONFIG_PINCONF=y
CONFIG_POWER_DOMAIN=y
CONFIG_DM_REGULATOR=y
CONFIG_DM_REGULATOR_FIXED=y
CONFIG_DM_SERIAL=y
CONFIG_SYS_NS16550=y
CONFIG_SPI=y
CONFIG_DM_SPI=y
CONFIG_AIROHA_SNFI_SPI=y
CONFIG_MTD_UBI=y
CONFIG_MTD_UBI_WL_THRESHOLD=4096
CONFIG_MTD_UBI_BEB_LIMIT=20
# CONFIG_MTD_UBI_FASTMAP is not set
CONFIG_SHA256=y
CONFIG_HASH=y
# CONFIG_MMC is not set
# CONFIG_PCI is not set
# CONFIG_USB is not set
# CONFIG_CMD_ELF is not set
# CONFIG_CMD_XIMG is not set
# CONFIG_CMD_BOOTEFI is not set
# CONFIG_CMD_GO is not set
```
